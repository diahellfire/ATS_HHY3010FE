//Included
#include <SPI.h>
#include <Wire.h>
#include <EEPROM.h>
#include <SoftwareSerial.h>

//OLED
#include <Adafruit_GFX.h>
#include <Adafruit_SSD1306.h>
//RTC ?
#include "Arduino.h"
#include "Wire.h"
//1-Wire
#include <DallasTemperature.h>
// Init the DS1307
#include <DS1307.h>

const int CityCheckPin              = 2; // Контакты от реле смотряцего в городскую сеть     
const int GeneratorCheckPin         = 4; // Контакты реле, смотрящие на запуск генератора
const int ServoChokePin             = 3; // Сервопривод заслонки подсоса
const int GeneratorPowerOnRelayPin  = 5; // Включение зажигания
const int GeneratorStarterRelayPin  = 6; // Запуск стартера
const int ChokeOpenPin              = 7; // Реле заслонки подсоса - открытие
const int ChokeClosePin             = 8; // Реле заслонки подсоса - закрытие
//const int ChokeClosePin             = 10;// 
const int DSWirePin                 = 9; // Термодатчик 18b20 (Для получения температуры ДВС)
const int GasolineLevelPin          = 12;// Датчик уровня топлива
const int BeeperPin                 = 13;// Датчик уровня топлива
const int ButtonStopPin             = 11;// Кнопка экстренного СТОПА

// Global variables
float EngineTemp;
int PrepareToStart = 0;
int CityCheckState = 0;
int GeneratorCheckState = 0;
int ButtonStopState = 0;
int GasolineLevelState = 0;
int ChokeClosePos = 0;
int ChokeOpenPos = 1;
int StartEnable = 0;
int EngineOn = 0;
int ChargerStart = 0;

// Declaration for an SSD1306 display connected to I2C (SDA, SCL pins)
#define OLED_RESET     4 // Reset pin # (or -1 if sharing Arduino reset pin)
Adafruit_SSD1306 display(OLED_RESET);

#define ONE_WIRE_BUS 9
OneWire oneWire(ONE_WIRE_BUS);
DallasTemperature dallasSensors(&oneWire);
DeviceAddress sensorAddress;

DS1307  rtc(SDA, SCL);
Time  t;

/////////////////////////////// images /////////////////////////////////////////////
static const unsigned char PROGMEM nogasoline[] = {
  B00000000, B00000000, B00000000, B00000000, B00000000, B00000000, B00000000, B00000000, 
  B00000000, B00000000, B00000000, B00000000, B00000000, B00000000, B00000000, B00000000, 
  B00000000, B00000000, B00000000, B00000000, B00000000, B00000000, B00000000, B00000000, 
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  B00000000, B00000000, B00000000, B00000000, B00000000, B00000000, B00000000, B00000000,
};

static const unsigned char PROGMEM generatorpower[] = {
  B00000000, B00000000, B00000000, B00000000, B00000000, B00000000, B00000000, B00000000, 
  B00000000, B00000000, B00000000, B00000000, B00000000, B00000000, B00000000, B00000000, 
  B00000000, B00000000, B00000000, B00000000, B00000000, B00000000, B00000000, B00000000, 
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  B00000000, B00000000, B00000000, B00000000, B00000000, B00000000, B00000000, B00000000, 
  
};

static const unsigned char PROGMEM citypower[] = {
  B00000000, B00000000, B00000000, B00000000, B00000000, B00000000, B00000000, B00000000, 
  B00000000, B00000000, B00000000, B00000000, B00000000, B00000000, B00000000, B00000000, 
  B00000000, B00000000, B00000000, B00000000, B00000000, B00000000, B00000000, B00000000, 
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  B00000000, B00000000, B00000000, B00000000, B00000000, B00000000, B00000000, B00000000, 
  
};

static const unsigned char PROGMEM checkengine[] = {
  B00000000, B00000000, B00000000, B00000000, B00000000, B00000000, B00000000, B00000000, 
  B00000000, B00000000, B00000000, B00000000, B00000000, B00000000, B00000000, B00000000, 
  B00000000, B00000000, B00000000, B00000000, B00000000, B00000000, B00000000, B00000000, 
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  B00000000, B00000000, B00000000, B00000000, B00000000, B00000000, B00000000, B00000000,
};

static const unsigned char PROGMEM emergencystop[] = {
  B00000000, B00000000, B00000000, B00000000, B00000000, B00000000, B00000000, B00000000, 
  B00000000, B00000000, B00000000, B00000000, B00000000, B00000000, B00000000, B00000000, 
  B10011100, B00111110, B00011110, B00001111, B00001111, B10000111, B10000011, B11000001, 
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  B00000000, B00000000, B00000000, B00000000, B00000000, B00000000, B00000000, B00000000,   
};

static const unsigned char PROGMEM lowpower[] = {
  B00000000, B00000000, B00000000, B00000000, B00000000, B00000000, B00000000, B00000000, 
  B00000000, B00000000, B00000000, B00000000, B00000000, B00000000, B00000000, B00000000, 
  B00000000, B00000000, B00000000, B00111111, B11111100, B00000000, B00000000, B00000000, 
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  B00000000, B00000000, B00000000, B00000000, B00000000, B00000000, B00000000, B00000000, 
};

static const unsigned char PROGMEM charge[] = {
  B00000000, B00000000, B00000000, B00000000, B00000000, B00000000, B00000000, B00000000, 
  B00000000, B00000000, B00000000, B00000000, B00000000, B00000000, B00000000, B00000000, 
  B00000000, B00000000, B00000000, B00000000, B00000000, B00000000, B00000000, B00000000, 
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  B00000000, B00000000, B00000000, B00000000, B00000000, B00000000, B00000000, B00000000,
};

static const unsigned char PROGMEM heat[] = {
  B00000000, B00000000, B00000000, B00000000, B00000000, B00000000, B00000000, B00000000, 
  B00000000, B00000000, B00000000, B00000000, B00000011, B01100000, B00000000, B00000000, 
  B00000000, B00000000, B00000000, B00000100, B00000110, B00010000, B00000000, B00000000, 
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  B00000000, B00000000, B00000000, B00000000, B00000000, B00000000, B00000000, B00000000,
};

static const unsigned char PROGMEM cold[] = {
B00000000, B00000000, B00000000, B00000000, B00000000, B00000000, B00000000, B00000000, 
  B00000000, B00000000, B00000000, B00000000, B00000000, B00000111, B10011110, B00000000, 
  B00000000, B00000000, B00000000, B00000000, B00000000, B00001110, B00000011, B00000000, 
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  B00000000, B00000000, B00000000, B00000000, B00000000, B00000000, B00000000, B00000000
};

static const unsigned char PROGMEM start[] = {
  B00000000, B00000000, B00000000, B01111111, B11100000, B00000000, B00000000, B00000000, 
  B00000000, B00000000, B00000001, B11111111, B11100001, B11100000, B00000000, B00000000, 
  B00000000, B00000000, B01100000, B11111111, B11000011, B11111110, B00000000, B00000000, 
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  B00000000, B00000000, B00000000, B00000000, B00000000, B00000011, B10000000, B00000000,
};
////////////////////////////////////////////////////////////////////////////

void setup() {
//Запуск последовательный порт
Serial.begin(9600);

//Запускаем дисплей
display.begin(SSD1306_SWITCHCAPVCC, 0x3C);
display.clearDisplay();
display.display();
display.setTextColor(WHITE, BLACK);

pinMode(ButtonStopPin, INPUT);
pinMode(CityCheckPin, INPUT);
pinMode(GeneratorCheckPin, INPUT);
pinMode(GasolineLevelPin, INPUT);

pinMode(GeneratorPowerOnRelayPin, OUTPUT);
pinMode(GeneratorStarterRelayPin, OUTPUT);
pinMode(ChokeOpenPin, OUTPUT);
pinMode(ChokeClosePin, OUTPUT);

// Set the clock to run-mode
rtc.begin();
rtc.halt(false);

//Заслонка при старте
choke(ChokeClosePos);

// Запускаем термометр
dallasSensors.begin();

draw_bitmap(citypower);
}

void loop() {
  init:
  Serial.println("Init.");
  Serial.print(rtc.getDateStr());
  Serial.print(" -- ");
  // Send time
  Serial.println(rtc.getTimeStr());
  t.year = EEPROM.read(15)+2000;
  t.mon = EEPROM.read(16);
  t.date = EEPROM.read(17);
  t.hour = EEPROM.read(18); // Возможно придется поменять на дневные часы (12-14)
  t.min = EEPROM.read(19);
  t.sec = 0;
  Serial.print("Last work date is ");
  Serial.print(t.date, DEC);
  Serial.print("-");
  Serial.print(t.mon, DEC);
  Serial.print("-");
  Serial.print(t.year, DEC);
  Serial.print(" ");
  
  // Send Day-of-Week and time
  Serial.print(" ");
  Serial.print(t.hour, DEC);
  Serial.print(":");
  Serial.print(t.min, DEC);
  Serial.print(":");
  Serial.print(t.sec, DEC);
  Serial.println("");
  
  dallasSensors.requestTemperatures(); // Просим ds18b20 собрать данные
  EngineTemp = dallasSensors.getTempCByIndex(0);
  Serial.print("Engine temperature: ");
  Serial.println(EngineTemp);
  if(EngineTemp == -127){
    Serial.print("DS18B20 is offline -- use cold engine temperature = 10 ");
    Serial.println(EngineTemp);
    EngineTemp = 10; // DS18B20 отключен, используем значение по умолчанию 10С - холодный двигатель
  }

  // Получение значения портов
  ButtonStopState = digitalRead(ButtonStopPin);
  CityCheckState = digitalRead(CityCheckPin); 
  GeneratorCheckState = digitalRead(GeneratorCheckPin);
  GasolineLevelState = digitalRead(GasolineLevelPin);

  // Если замкнута кнопка СТОП то выключить все реле, ждать размыкания
  if(ButtonStopState == HIGH){
    draw_bitmap(emergencystop);
    Serial.println("Manual stop detected -- System passed");
    digitalWrite(GeneratorPowerOnRelayPin, LOW);
    digitalWrite(GeneratorStarterRelayPin, LOW);
    PrepareToStart = 0;
    StartEnable = 0;
    delay(1000);
    goto init;
  }

  // Проверка уровня топлива, если разомкнулся, то пустой.
  if(GasolineLevelState == LOW){
    Serial.println("Low Gasoline Level -- System Passed");
    draw_bitmap(nogasoline);
    delay(1000);
    goto init;
  }

  CheckLast();

  // Запуск генератора 
  // Отключение городской сети
  if(CityCheckState == HIGH && EngineOn == 0 && PrepareToStart == 0){
    draw_bitmap(lowpower);
    Serial.println("City power offline -- prepare to start engine");
    PrepareToStart=1;
  }

  if(CityCheckState == LOW){
    draw_bitmap(citypower);
  }

  // Если включили питание раньше запуска генератора - отключаем счетчик - закрываем заслонку подсоса.
  if(CityCheckState == LOW && PrepareToStart > 0 && EngineOn == 0){
    Serial.println("City power online -- decline start engine");
    PrepareToStart = 0;
    StartEnable = 0;
    draw_bitmap(citypower);
    choke(ChokeClosePos); // Закрываем заслонку подсоса
    goto init;
  }

  // Если включили питание и запуска генератора произведен.
  if(CityCheckState == LOW && EngineOn == 1){
    delay(5000);
    Serial.println("City power online -- stopped engine");
    SaveLastOff();
    PrepareToStart = 0;
    StartEnable = 0;
    draw_bitmap(citypower);
    digitalWrite(GeneratorPowerOnRelayPin, LOW); // Отключаем зажигание генератора
    EngineOn = 0;
    goto init;
  }
  
  // Отсчет до запуска
  if(PrepareToStart > 0){
    PrepareToStart++; 
    if(EngineTemp < 40){
      draw_bitmap(cold);
      if(PrepareToStart == 1){
        choke(ChokeOpenPos); // Заранее открываем заслонку подсоса если двигатель холодный
      }
    }else{
      draw_bitmap(heat);
      choke(ChokeClosePos);
    }
    delay(1000);
    draw_bitmap(lowpower);
  }  
  
  // Ожидане до 10 секунд на обратное включение сети
  if(PrepareToStart == 10){
    PrepareToStart = 0; // Reset counter checker
    StartEnable = 1; // разрешаем старт двигателя
  }
  
  // Разрешен двигателя (StartEnable)
  if(StartEnable == 1){
    Serial.println("Start Engine -- ");
    draw_bitmap(start);
    // Подаем питание на стартер
    digitalWrite(GeneratorPowerOnRelayPin, HIGH);
    delay(1000);
    
    // Пробуем 4 раза запустить двигатель
    for (int StarterProbeToStart = 0; StarterProbeToStart < 4; StarterProbeToStart++) {
      digitalWrite(GeneratorStarterRelayPin, HIGH);
      delay(4000); // Крутим стартер 4 секунды
      digitalWrite(GeneratorStarterRelayPin, LOW);
      delay(3000); // Ждем 3 секунды перед проверкой питания
      GeneratorCheckState = digitalRead(GeneratorCheckPin);
      if(GeneratorCheckState == HIGH){
        // OK Генератор завелся
        Serial.println("Engine -- Started!");
        EngineOn = 1;
        StartEnable = 0;
        delay(2000); // ждем 2 секунды перед закрытием подсоса
        choke(ChokeClosePos); // Закрываем заслонку подсоса
        break;
      }else{
        // FAIL Генератор не завелся
        Serial.println("Engine -- Not Started! [repeat to start]");
        EngineOn = 0;
        if(StarterProbeToStart == 2){
          choke(ChokeClosePos); // Закрываем заслонку подсоса - возможно двигатель горячий
        }
      }
    }
    
    if(EngineOn == 0){
      // Генератор не смог завестись, требуется проверка (Ожидание часа перед следующей попыткой)!
      draw_bitmap(checkengine);    
      Serial.println("Error: Generator damaged!");
      delay(3600000);
    }
    
    if(EngineOn == 1){
      // Генератор польностью готов к подаче питания
      draw_bitmap(generatorpower);
    }
  }

  if(GeneratorCheckState == LOW && EngineOn == 1){
    // Генератор заглох
    Serial.println("Error: Generator stopped!");
    digitalWrite(GeneratorPowerOnRelayPin, LOW);
    draw_bitmap(checkengine);
    delay(5000);
    EngineOn=0;
  }
  if(GeneratorCheckState == HIGH && EngineOn == 0){
    // Генератор не смог остановиться
    Serial.println("Error: Generator not stopped!");
    digitalWrite(GeneratorPowerOnRelayPin, LOW);
    draw_bitmap(checkengine);
    delay(5000);
    EngineOn=0;
  }

  delay(1000);
}

int SaveLastOff() {
  // Запись события последнего остановки генератора
  // Блок ячейки с 15 по 19
  // ГГ[15] - ММ[16] - ДД[17] - ЧЧ[18] - ММ[19]
  t = rtc.getTime();
  EEPROM.write(15, t.year-2000);
  EEPROM.write(16, t.mon);
  EEPROM.write(17, t.date);
  EEPROM.write(18, t.hour);
  EEPROM.write(19, t.min);
}

void CheckLast(){
  // Получение ячейки последнего запуска генератора
  t.year = EEPROM.read(15)+2000;
  t.mon = EEPROM.read(16);
  t.date = EEPROM.read(17);
  t.hour = EEPROM.read(18); // Возможно придется поменять на дневные часы (12-14)
  t.min = EEPROM.read(19);
  t.sec = 0;
  int laststop = rtc.getUnixTime(t); // Время в секундах последней остановки генератора
  int curr = rtc.getUnixTime(rtc.getTime()); // текущее время
  if ((curr - 2592000) >= laststop){
    Serial.println("Need automatic start - to charge mode");
    ChargerStart = 1;
    draw_bitmap(charge);
  }

  if(ChargerStart == 1){
    Serial.println("Charge mode Start Engine -- ");
    choke(ChokeOpenPos); // Открываем заслонку подсоса
    // Подаем питание на стартер
    digitalWrite(GeneratorPowerOnRelayPin, HIGH);
    delay(1000);
    
    // Пробуем 4 раза запустить двигатель
    for (int StarterProbeToStart = 0; StarterProbeToStart < 4; StarterProbeToStart++) {
      digitalWrite(GeneratorStarterRelayPin, HIGH);
      delay(4000); // Крутим стартер 4 секунд
      digitalWrite(GeneratorStarterRelayPin, LOW);
      delay(3000); // Ждем 3 секунды перед проверкой питания
      GeneratorCheckState = digitalRead(GeneratorCheckPin);
      if(GeneratorCheckState == HIGH){
        // OK Генератор завелся
        Serial.println("Charge mode Engine -- Started!");
        EngineOn = 1;
        ChargerStart = 0;
        delay(10000); // ждем 10 секунд перед закрытием подсоса
        choke(ChokeClosePos); // Закрываем заслонку подсоса
        break;
      }else{
        // FAIL Генератор не завелся
        Serial.println("Charge mode Engine -- Not Started! [repeat to start]");
        EngineOn = 0;
      }
    }
    
    if(EngineOn == 0){
      // Генератор не смог завестись, требуется проверка (Ожидание часа перед следующей попыткой)!
      draw_bitmap(checkengine);
      Serial.println("Error: Generator damaged!");
      delay(3600000);
    }
    
    if(EngineOn == 1){
      // Генератор полностью готов к зарядке
      draw_bitmap(charge);
      delay(900000); // Прогрев и зарядка 15 минут
      digitalWrite(GeneratorPowerOnRelayPin, LOW);
      SaveLastOff();
      EngineOn = 0;
    }
  }
  
}

void draw_text(byte x_pos, byte y_pos, String text, byte text_size) {
  // Отрисовка текста (НЕ ИСПОЛЬЗУЕТСЯ)
  display.setCursor(x_pos, y_pos);
  display.setTextSize(text_size);
  display.print(text);
  display.display();
}

void draw_bitmap(const uint8_t *bitmap) {
  // Отрисовка изображений на экране
  display.clearDisplay();
  display.drawBitmap((display.width()  - 64 ) / 2, (display.height() - 32) / 2, bitmap, 64, 32, 1);
  display.display();
}

//int choke(int pos){
  // Отказ от использования сервопривода - не хватает тяги для поворота заслонки
  // Запускаем сервопривод
  // Для экономии питания включаем и отключаем серву при использовании
  //servochoke.attach(ServoChokePin);
  //servochoke.write(pos);
  //delay(2000);
  //servochoke.detach();
//}

int choke(int pos){
  // Заслонка подсоса - соленоид
  // Закрыта
  if(pos == 0){
    digitalWrite(ChokeOpenPin, HIGH);
    delay(2000);
    digitalWrite(ChokeOpenPin, LOW);
  }
  // открыта
  if(pos == 1){
    digitalWrite(ChokeClosePin, HIGH);
    delay(2000);
    digitalWrite(ChokeClosePin, LOW);    
  }
}
